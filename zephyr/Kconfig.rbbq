## zephyr/Kconfig.rbbq
```kconfig
# Copyright (c) 2020, 2021 Bobby Noelte
# SPDX-License-Identifier: Apache-2.0

menuconfig THINGSET_RBBQ
	bool "ThingSet RBBQ library"
	default n
	select POLL
	help
	  This option enables the ThingSet RBBQ library.

if THINGSET_RBBQ

module = THINGSET_RBBQ
module-str = rbbq
source "subsys/logging/Kconfig.template.log_config"

rsource "Kconfig.rbbq_local"
#rsource "Kconfig.rbbq_spi"

endif # RBBQ_BY_ZXT
```

## zephyr/Kconfig.rbbq_local
```kconfig
# Copyright (c) 2020, Bobby Noelte
# SPDX-License-Identifier: Apache-2.0

# Kconfig - rbbq_local C library options

config THINGSET_RBBQ_LOCAL
	bool "ThingSet RBBQ - via LOCAL connection"
	default n

if THINGSET_RBBQ_LOCAL

config THINGSET_RBBQ_LOCAL0
	bool "RBBQ buffer for LOCAL device 0"
	default n

if THINGSET_RBBQ_LOCAL0

config THINGSET_RBBQ_LOCAL0_TRANSFER_BUFFER_SIZE
	int "Size of the circular buffers for RX and TX"
	default 512
	help
	  Size of circular buffers. Must be aligned to 2.

endif # THINGSET_RBBQ_LOCAL0

config THINGSET_RBBQ_LOCAL1
	bool "RBBQ buffer for LOCAL device 1"
	default n

if THINGSET_RBBQ_LOCAL1

config THINGSET_RBBQ_LOCAL1_TRANSFER_BUFFER_SIZE
	int "Size of the circular buffers for RX and TX"
	default 512
	help
	  Size of circular buffers. Must be aligned to 2.

endif # THINGSET_RBBQ_LOCAL1

endif # THINGSET_RBBQ_LOCAL
```

## zephyr/Kconfig.thingset_com
```kconfig
# Copyright (c) 2021 Bobby Noelte
# SPDX-License-Identifier: Apache-2.0

config THINGSET_COM
        bool "ThingSet Communication Support"
        select NET_BUF
        help
          This option enables the ThingSet communication support.

if THINGSET_COM

config THINGSET_COM_BUF_COUNT
        int "Number of communication buffers in the ThingSet buffer pool."
        default 16
        help
          Number of communication buffers in ThingSet device's buffer pool.

config THINGSET_COM_BUF_DATA_SIZE
        int "Data block size for ThingSet communication buffers."
        default 1024
        help
          Data block size for all ThingSet communication buffers. Buffers are allocated from this
          block.

module = THINGSET_COM
module-str = thingset_com
source "subsys/logging/Kconfig.template.log_config"

endif
```

## zephyr/Kconfig.thingset_mesh
```kconfig
# Copyright (c) 2021 Bobby Noelte
# SPDX-License-Identifier: Apache-2.0

config THINGSET_MESH
        bool "ThingSet Mesh"
        select THINGSET_COM
        select NET_BUF
        help
          This option enables the ThingSet Mesh networking support.

if THINGSET_MESH

config THINGSET_MESH_BUF_COUNT
        int "Number of network buffers in th ThingSet Mesh buffer pool."
        default 16
        help
          Number of network buffers in ThingSet Mesh buffer pool.

config THINGSET_MESH_BUF_DATA_SIZE
        int "Data block size for ThingSet Mesh network messages."
        default 1024
        help
          Data block size for all ThingSet Mesh network messages. Messages are
          allocated from this block.

config THINGSET_MESH_NODE_COUNT
        int "Number of node entries in the node table."
        default 16
        help
          Number of nodes that routing information is cached for in the
          node table. Nodes may be either neighbours or originators of
          messages.

config THINGSET_MESH_NODE_PATHS_MAX
        int "Maximum number of routing entries per node in the node table."
        default 2
        help
          Maximum number of routing entries per node in the node table.

config THINGSET_MESH_TRANSLATION_COUNT
        int "Number of translation entries in the translation table."
        default 16
        help
          Number of translation entries in the translation table. Translates
          between device specific IDs used in binary messages and the text
          representation.

config THINGSET_MESH_NODE_SEQNO_EXPECTED_RANGE
        int "Expected node sequence number range for valid messages."
        default 10
        help
           A valid message has to have a node sequence number that is greater than the last valid
           node sequence number reduced by TSM_NODE_SEQNO_EXPECTED_RANGE and is less than the last
           valid node sequence number advanced by TSM_NODE_SEQNO_EXPECTED_RANGE taking into account
           roll over.

config CONFIG_THINGSET_MESH_NODE_SEQNO_CACHE_SIZE
        int "Size of cache for node sequence numbers for protection window."
        default 8
        help
           Size of cache for node sequence numbers for protection window.

module = THINGSET_MESH
module-str = thingset_mesh
source "subsys/logging/Kconfig.template.log_config"

endif
```
